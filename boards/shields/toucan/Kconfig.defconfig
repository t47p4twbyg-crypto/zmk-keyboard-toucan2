## boards/shields/toucan/Kconfig.defconfig
```kconfig
if SHIELD_TOUCAN_DONGLE

# キーボード名は最大16文字以内
config ZMK_KEYBOARD_NAME
    default "Toucan2"

config ZMK_SPLIT_ROLE_CENTRAL
    default y

config ZMK_SPLIT
    default y

# 左右2パーツなので 2
config ZMK_SPLIT_BLE_CENTRAL_PERIPHERALS
    default 2

# ペリフェラル数 + BTプロファイル数（例: 2 + 5 = 7）
config BT_MAX_CONN
    default 7

config BT_MAX_PAIRED
    default 7

endif
```
